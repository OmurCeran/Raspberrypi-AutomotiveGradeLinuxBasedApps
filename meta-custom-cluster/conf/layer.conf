## meta-custom-cluster/conf/layer.conf
```bitbake
# We have a conf and classes directory, add to BBPATH
BBPATH .= ":${LAYERDIR}"

# We have recipes-* directories, add to BBFILES
BBFILES += "${LAYERDIR}/recipes-*/*/*.bb \
            ${LAYERDIR}/recipes-*/*/*.bbappend"

BBFILE_COLLECTIONS += "meta-custom-cluster"
BBFILE_PATTERN_meta-custom-cluster = "^${LAYERDIR}/"
BBFILE_PRIORITY_meta-custom-cluster = "6"

LAYERDEPENDS_meta-custom-cluster = "core"
LAYERSERIES_COMPAT_meta-custom-cluster = "scarthgap"
```
